## soundcube_base/sdkconfig.defaults
```kconfig
CONFIG_BT_ENABLED=y
CONFIG_BTDM_CTRL_MODE_BR_EDR_ONLY=y
CONFIG_BT_BLUEDROID_ENABLED=y
CONFIG_BT_CLASSIC_ENABLED=y
CONFIG_BT_A2DP_ENABLE=y
CONFIG_DAC_DMA_AUTO_16BIT_ALIGN=n

CONFIG_EXAMPLE_A2DP_SINK_OUTPUT_EXTERNAL_I2S=y
CONFIG_EXAMPLE_I2S_LRCK_PIN=25
CONFIG_EXAMPLE_I2S_BCK_PIN=5
CONFIG_EXAMPLE_I2S_DATA_PIN=26
CONFIG_EXAMPLE_LOCAL_DEVICE_NAME="Soundcube"

CONFIG_ESPTOOLPY_FLASHMODE_DIO=y
CONFIG_ESPTOOLPY_FLASHFREQ_80M=y
CONFIG_ESPTOOLPY_FLASHSIZE_4MB=y
CONFIG_PARTITION_TABLE_SINGLE_APP=y
```
